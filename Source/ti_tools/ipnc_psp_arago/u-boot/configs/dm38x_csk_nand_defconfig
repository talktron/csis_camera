## Source/ti_tools/ipnc_psp_arago/u-boot/configs/dm38x_csk_nand_defconfig
```kconfig
CONFIG_ARM=y
CONFIG_TARGET_DM38X=y
CONFIG_SPL=y
CONFIG_NAND=y
CONFIG_SYS_EXTRA_OPTIONS="NAND,ENV_IS_IN_NAND,CONFIG_MODE_GMII,PHY_MMD_INDIRECT_WRITE"
CONFIG_HUSH_PARSER=y
CONFIG_DEFAULT_DEVICE_TREE="dm38x"
CONFIG_OF_CONTROL=y
CONFIG_OF_LIBFDT=y
CONFIG_SYS_PROMPT="DM388-CSIS# "
CONFIG_CMD_MMC=y
CONFIG_CMD_FAT=y
CONFIG_CMD_EXT2=y
CONFIG_SYS_NS16550=y
CONFIG_CMD_PING=y
CONFIG_CMD_MII=y
CONFIG_CMD_CSK_FF_INIT=y
CONFIG_CMD_I2C=y
# CONFIG_CMD_IMLS is not set
# CONFIG_CMD_FLASH is not set
# CONFIG_CMD_SETEXPR is not set
```
